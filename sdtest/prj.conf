## CMakeLists.txt
```
# SPDX-License-Identifier: Apache-2.0

cmake_minimum_required(VERSION 3.20.0)

set(BOARD_ROOT ${CMAKE_CURRENT_LIST_DIR}/..)

set(ZEPHYR_EXTRA_MODULES ${CMAKE_CURRENT_SOURCE_DIR}/..)

# Compatible boards for this app
set(COMPATIBLE_BOARDS
    ubcrocket_fc_2526_r1
)

if(NOT BOARD IN_LIST COMPATIBLE_BOARDS)
    message(WARNING 
        "Board '${BOARD}' is not listed as compatible with this application.\n"
        "Compatible boards: ${COMPATIBLE_BOARDS}\n"
        "Build may fail or behave unexpectedly.\n"
        "To add compatibility for this board, add it to the COMPATIBLE_BOARDS list in CMakeLists.txt.")
endif()

find_package(Zephyr REQUIRED HINTS $ENV{ZEPHYR_BASE})
project(sdtest)

target_sources(app PRIVATE src/main.c)
```

## prj.conf
```kconfig
# Enable SDMMC driver
#CONFIG_SDMMC=y
CONFIG_DISK_DRIVER_SDMMC=y

# Enable disk access API
CONFIG_DISK_ACCESS=y

# Enable file system support
CONFIG_FILE_SYSTEM=y
CONFIG_FAT_FILESYSTEM_ELM=y  # Use FATFS for SD cards

# Enable below for debugging only, not needed for normal operation
CONFIG_PRINTK=y # Enable printk
CONFIG_CBPRINTF_FP_SUPPORT=y # Floating point format support
CONFIG_LOG=y # Enable logging
CONFIG_LOG_MODE_IMMEDIATE=y # Immediate log mode
CONFIG_SENSOR_LOG_LEVEL_DBG=n # Sensor log level debug
CONFIG_SPI_LOG_LEVEL_DBG=n # Spi log level debug
CONFIG_GPIO_LOG_LEVEL_DBG=n # Gpio log level debug
CONFIG_BOOT_BANNER=y # Enable boot banner
CONFIG_ASSERT=n# Enable assertions
CONFIG_DEBUG=y # Enable debugging
CONFIG_NO_OPTIMIZATIONS=n # Disable optimizations
CONFIG_THREAD_MONITOR=n # Enable thread monitor
```

## src/main.c
```c
#include <zephyr/kernel.h>
#include <zephyr/device.h>
#include <zephyr/storage/disk_access.h>
#include <zephyr/fs/fs.h>
#include <zephyr/logging/log.h>

LOG_MODULE_REGISTER(main, LOG_LEVEL_INF);

// Mount point for the SD card
#define MOUNT_POINT "/SDCARD"

// FATFS mount structure
static struct fs_mount_t fatfs_mnt = {
    .type = FS_FATFS,
    .mnt_point = MOUNT_POINT,
};

void write_test_log(void) {
    struct fs_file_t file;
    int ret;

    // Open or create a file for writing
    ret = fs_open(&file, MOUNT_POINT "/test_log.txt", FS_O_CREATE | FS_O_WRITE);
    if (ret) {
        LOG_ERR("Failed to open file: %d", ret);
        return;
    }

    // Write some test logs to the file
    const char *log_data = "This is a test log written to the SD card.\n";
    ret = fs_write(&file, log_data, strlen(log_data));
    if (ret < 0) {
        LOG_ERR("Failed to write to file: %d", ret);
    } else {
        LOG_INF("Wrote %d bytes to file", ret);
    }

    // Close the file
    fs_close(&file);
}

void mount_sd_card(void) {
    int ret;

    // Initialize the SDMMC disk
    ret = disk_access_init("SDMMC");
    if (ret) {
        LOG_ERR("Disk access initialization failed: %d", ret);
        return;
    }

    // Mount the FATFS file system
    ret = fs_mount(&fatfs_mnt);
    if (ret == 0) {
        LOG_INF("File system mounted at %s", fatfs_mnt.mnt_point);
    } else {
        LOG_ERR("File system mount failed: %d", ret);
    }
}

int main(void) {
    LOG_INF("SD Test Application Started");

    // Mount the SD card
    mount_sd_card();

    // Write a test log to the SD card
    write_test_log();

    return 0;
}
```
