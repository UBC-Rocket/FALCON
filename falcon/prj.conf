## CMakeLists.txt
```
# SPDX-License-Identifier: Apache-2.0

cmake_minimum_required(VERSION 3.20.0)

set(BOARD_ROOT ${CMAKE_CURRENT_LIST_DIR}/..)

set(ZEPHYR_EXTRA_MODULES ${CMAKE_CURRENT_SOURCE_DIR}/..)

# Compatible boards for this app
set(COMPATIBLE_BOARDS
    ubcrocket_fc_2526_r1
)

if(NOT BOARD IN_LIST COMPATIBLE_BOARDS)
    message(WARNING 
        "Board '${BOARD}' is not listed as compatible with this application.\n"
        "Compatible boards: ${COMPATIBLE_BOARDS}\n"
        "Build may fail or behave unexpectedly.\n"
        "To add compatibility for this board, add it to the COMPATIBLE_BOARDS list in CMakeLists.txt.")
endif()

find_package(Zephyr REQUIRED HINTS $ENV{ZEPHYR_BASE})
project(falcon)

target_sources(app PRIVATE src/main.c src/data.c src/sensors/imu_thread.c src/logger_thread.c)
```

## prj.conf
```kconfig
# Enable GPIO support
CONFIG_GPIO=y

# Enable sensor subsystem
CONFIG_SENSOR=y

# Enable SPI support
CONFIG_SPI=y

# Enable C++ support
CONFIG_CPP=y

# Enable BMI08X sensor driver
CONFIG_BMI08X=y
CONFIG_BMI08X_ACCEL_TRIGGER_NONE=y
CONFIG_BMI08X_GYRO_TRIGGER_NONE=y

# Enable MS5607 and MS5611 barometer drivers
CONFIG_MS5607=y
CONFIG_MS5611=y

# Enable SDMMC disk driver and hardware flow control
CONFIG_DISK_DRIVER_SDMMC=y
CONFIG_SDMMC_STM32_HWFC=y

# Enable disk access API
CONFIG_DISK_ACCESS=y

# Enable file system support
CONFIG_FILE_SYSTEM=y
CONFIG_FAT_FILESYSTEM_ELM=y
CONFIG_FS_FATFS_LFN=y

# Set main thread stack size
CONFIG_MAIN_STACK_SIZE=2048

# Enable debugging features (for development only)
CONFIG_PRINTK=y
CONFIG_CBPRINTF_FP_SUPPORT=y
CONFIG_LOG=y
CONFIG_LOG_MODE_IMMEDIATE=y
CONFIG_SENSOR_LOG_LEVEL_DBG=n
CONFIG_SPI_LOG_LEVEL_DBG=n
CONFIG_GPIO_LOG_LEVEL_DBG=n
CONFIG_BOOT_BANNER=y
CONFIG_ASSERT=n
CONFIG_DEBUG=y
CONFIG_NO_OPTIMIZATIONS=y

# Enable thread debugging features
CONFIG_DEBUG_THREAD_INFO=y
CONFIG_THREAD_MONITOR=y
CONFIG_THREAD_NAME=y
CONFIG_THREAD_STACK_INFO=n
CONFIG_STACK_SENTINEL=y
```

## src/main.c
```c
#include <zephyr/kernel.h>
#include <zephyr/device.h>
#include <zephyr/devicetree.h>
#include <zephyr/drivers/sensor.h>
#include <zephyr/logging/log.h>
#include "sensors/imu_thread.h"
#include "logger_thread.h"
#include "data.h"

LOG_MODULE_REGISTER(falcon_main, LOG_LEVEL_INF);

int main(void)
{
    LOG_INF("Falcon application started");

    // Sensor sleep times in milliseconds
    uint32_t imu_sleep_time_ms = 50;

    // Start the threads
    start_imu_thread(&imu_sleep_time_ms);
    start_logger_thread();

    while (1) {
    //     struct imu_data imu_sample;

    //     // Retrieve the latest IMU data
    //     get_imu_data(&imu_sample);

    //     // Log the IMU data
    //     LOG_INF("IMU Data: Accel [X=%.3f, Y=%.3f, Z=%.3f] m/s^2, "
    //             "Gyro [X=%.3f, Y=%.3f, Z=%.3f] rad/s, "
    //             "Timestamp: %lld ms",
    //             imu_sample.accel[0], imu_sample.accel[1], imu_sample.accel[2],
    //             imu_sample.gyro[0], imu_sample.gyro[1], imu_sample.gyro[2],
    //             imu_sample.timestamp);

        // Sleep for 1 second
        k_sleep(K_SECONDS(1));
    }

    return 0;
}
```

## src/data.c
```c
#include <zephyr/kernel.h>
#include <zephyr/logging/log.h>
#include "data.h"

LOG_MODULE_REGISTER(data, LOG_LEVEL_INF);

// Global instances
struct imu_data g_imu_data;
struct baro_data g_baro_data;

// Mutexes for thread safety
K_MUTEX_DEFINE(imu_mutex);
K_MUTEX_DEFINE(baro_mutex);

// Setter functions
void set_imu_data(const struct imu_data *src)
{
    k_mutex_lock(&imu_mutex, K_FOREVER);
    g_imu_data = *src;
    k_mutex_unlock(&imu_mutex);
}

void set_baro_data(const struct baro_data *src)
{
    k_mutex_lock(&baro_mutex, K_FOREVER);
    g_baro_data = *src;
    k_mutex_unlock(&baro_mutex);
}

// Getter functions
void get_imu_data(struct imu_data *dst)
{
    k_mutex_lock(&imu_mutex, K_FOREVER);
    *dst = g_imu_data;
    k_mutex_unlock(&imu_mutex);
}

void get_baro_data(struct baro_data *dst)
{
    k_mutex_lock(&baro_mutex, K_FOREVER);
    *dst = g_baro_data;
    k_mutex_unlock(&baro_mutex);
}
```

## src/data.h
```c
#ifndef DATA_H
#define DATA_H

#include <stdint.h>

// Data structures for sensor data
struct imu_data
{
    float accel[3];    // Acceleration in m/s²
    float gyro[3];     // Angular velocity in rad/s
    int64_t timestamp; // Timestamp in milliseconds
};

struct baro_data
{
    float pressure;    // Pressure in hPa (same as mBar)
    float temperature; // Temperature in °C
    float altitude;    // Altitude in meters
    int64_t timestamp; // Timestamp in milliseconds
};

// Global instances
extern struct imu_data g_imu_data;
extern struct baro_data g_baro_data;

// Getters and setters
void set_imu_data(const struct imu_data *src);
void get_imu_data(struct imu_data *dst);

void set_baro_data(const struct baro_data *src);
void get_baro_data(struct baro_data *dst);

#endif
```

## src/log_format.h
```c
#ifndef LOG_FORMAT_H
#define LOG_FORMAT_H

#include "data.h"
#include <stdint.h>

struct log_frame
{
    int64_t log_timestamp;

    struct imu_data imu;
    struct baro_data baro;
};

#endif
```

## src/logger_thread.c
```c
#include <zephyr/kernel.h>
#include <zephyr/sys/printk.h>
#include <zephyr/logging/log.h>
#include "data.h"
#include "log_format.h"

LOG_MODULE_REGISTER(logger_thread, LOG_LEVEL_INF);

#define LOGGER_THREAD_STACK_SIZE 2048
#define LOGGER_THREAD_PRIORITY   7
#define LOGGER_THREAD_PERIOD_MS  1000

K_THREAD_STACK_DEFINE(logger_stack, LOGGER_THREAD_STACK_SIZE);
static struct k_thread logger_thread;

static void logger_thread_fn(void *p1, void *p2, void *p3)
{
    struct log_frame frame;

    while (1) {
        k_sleep(K_MSEC(LOGGER_THREAD_PERIOD_MS));

        frame.log_timestamp = k_uptime_get();

        get_imu_data(&frame.imu);
        get_baro_data(&frame.baro);

        //temporary logging output
        LOG_INF("Time=%lld Accel[0]=%.3f",
        frame.log_timestamp,
        (double)frame.imu.accel[0]);
    }
}

void start_logger_thread()
{
    k_thread_create(
        &logger_thread,
        logger_stack,
        K_THREAD_STACK_SIZEOF(logger_stack),
        logger_thread_fn,
        NULL, NULL, NULL,
        LOGGER_THREAD_PRIORITY,
        0,
        K_NO_WAIT
    );
}
```

## src/logger_thread.h
```c
#ifndef LOGGER_THREAD_H
#define LOGGER_THREAD_H

#include <stdint.h>

void start_logger_thread();

#endif
```
