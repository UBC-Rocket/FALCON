## drivers/spi/sim_radio/Kconfig
```kconfig
config SIM_RADIO
    bool "Simulated GNSS/Radio Board"
    depends on DT_HAS_ZEPHYR_SIM_RADIO_ENABLED
```

## dts/bindings/spi/zephyr,sim-radio.yaml
```yaml
description: Simulated GNSS/Radio Device

compatible: "zephyr,sim-radio"

include: [spi-device.yaml]

properties:
  reg:
    required: true

  spi-max-frequency:
    required: true
```

## firmware/tests/integration/testcase.yaml
```yaml
tests:
    cloudburst.integration:
        platform_allow: ubcrocket_polarity
        tags: state_machine
        type: unit
```

## firmware/tests/rfd900x/testcase.yaml
```yaml
tests:
    cloudburst.rfd900x:
        platform_allow:
          - ubcrocket_polarity
          - native_sim/native/64
        tags: radio
        type: unit
```
