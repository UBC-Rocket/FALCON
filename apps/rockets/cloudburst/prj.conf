## CMakeLists.txt
```
# SPDX-License-Identifier: Apache-2.0

cmake_minimum_required(VERSION 3.20.0)

list(APPEND DTS_ROOT ${CMAKE_CURRENT_SOURCE_DIR})

set(BOARD_ROOT ${CMAKE_CURRENT_LIST_DIR}/../../..)

set(ZEPHYR_EXTRA_MODULES ${CMAKE_CURRENT_LIST_DIR}/../../..)

# Compatible boards for this app
set(COMPATIBLE_BOARDS
    ubcrocket_fc_2526_r1
    native_sim/native/64
    native_sim
)

if(NOT BOARD IN_LIST COMPATIBLE_BOARDS)
    message(WARNING 
        "Board '${BOARD}' is not listed as compatible with this application.\n"
        "Compatible boards: ${COMPATIBLE_BOARDS}\n"
        "Build may fail or behave unexpectedly.\n"
        "To add compatibility for this board, add it to the COMPATIBLE_BOARDS list in CMakeLists.txt.")
endif()

find_package(Zephyr REQUIRED HINTS $ENV{ZEPHYR_BASE})
project(cloudburst)

target_sources(app PRIVATE
  src/main.c
  src/data.c
  src/sensors/imu_thread.c
  src/logger_thread.c
  src/sensors/baro_thread.c
  src/state_machine/state_machine.c
  src/state_machine/state_machine_common.c
  src/state_machine/states/standby.c
  src/state_machine/states/ascent.c
  src/state_machine/states/mach_lock.c
  src/state_machine/states/drogue_descent.c
  src/state_machine/states/main_descent.c
  src/state_machine/states/landed.c
  src/pyro/pyro_thread.c
)

target_include_directories(app PRIVATE
  src
  src/state_machine
)

if(DEFINED DATA_FILE)
  zephyr_compile_definitions(DATA_FILE="${DATA_FILE}")
endif()
```

## prj.conf
```kconfig
# Enable simulated sensors for native_sim
CONFIG_SIM_BARO=y
CONFIG_SIM_ACCEL=y
CONFIG_SIM_GYRO=y
CONFIG_SIM_PYRO=y
CONFIG_SIM_SDMMC=y

# Enable fake sensors for native_sim
CONFIG_EMUL=y
CONFIG_SENSOR_SHELL=y

# Enable the random number generator for native_sim
CONFIG_ENTROPY_GENERATOR=y

# Enable RAM disk driver for native_sim
CONFIG_DISK_DRIVER_RAM=y

# Enable GPIO support
CONFIG_GPIO=y

# Enable sensor subsystem
CONFIG_SENSOR=y

# Enable SPI support
CONFIG_SPI=y

# Enable C++ support
CONFIG_CPP=y

# Enable SMF (state machine framework)
CONFIG_SMF=y

# Enable BMI08X sensor driver
CONFIG_BMI08X=y
CONFIG_BMI08X_ACCEL_TRIGGER_NONE=y
CONFIG_BMI08X_GYRO_TRIGGER_NONE=y

# Enable MS5607 and MS5611 barometer drivers
CONFIG_MS5607=y
CONFIG_MS5611=y

# Enable SDMMC disk driver and hardware flow control
CONFIG_DISK_DRIVER_SDMMC=y
CONFIG_SDMMC_STM32_HWFC=y

# Enable disk access API
CONFIG_DISK_ACCESS=y

# Enable file system support
CONFIG_FILE_SYSTEM=y
CONFIG_FAT_FILESYSTEM_ELM=y
CONFIG_FS_FATFS_LFN=y

# Set main thread stack size
CONFIG_MAIN_STACK_SIZE=2048

# Enable sensor asynchronous API
CONFIG_SENSOR_ASYNC_API=y

# Enable debugging features (for development only)
CONFIG_PRINTK=y
CONFIG_CBPRINTF_FP_SUPPORT=y
CONFIG_LOG=y
CONFIG_LOG_MODE_IMMEDIATE=y
CONFIG_SENSOR_LOG_LEVEL_DBG=n
CONFIG_SPI_LOG_LEVEL_DBG=n
CONFIG_GPIO_LOG_LEVEL_DBG=n
CONFIG_BOOT_BANNER=y
CONFIG_ASSERT=n
CONFIG_DEBUG=y
CONFIG_NO_OPTIMIZATIONS=y

# Enable thread debugging features
CONFIG_DEBUG_THREAD_INFO=y
CONFIG_THREAD_MONITOR=y
CONFIG_THREAD_NAME=y
CONFIG_THREAD_STACK_INFO=n
CONFIG_STACK_SENTINEL=y
```

## src/main.c
```c
#include "data.h"
#include "logger_thread.h"
#include "pyro/pyro_thread.h"
#include "sensors/baro_thread.h"
#include "sensors/imu_thread.h"
#include "state_machine/state_machine.h"
#include <zephyr/device.h>
#include <zephyr/devicetree.h>
#include <zephyr/drivers/sensor.h>
#include <zephyr/kernel.h>
#include <zephyr/logging/log.h>

LOG_MODULE_REGISTER(falcon_main, LOG_LEVEL_INF);

int main(void)
{
    LOG_INF("Falcon application started");

    // Start the threads
    start_imu_thread();
    start_logger_thread();
    start_baro_thread();
    start_pyro_thread();
    start_state_machine_thread();

    return 0;
}
```

## src/data.c
```c
#include "data.h"
#include <zephyr/kernel.h>
#include <zephyr/logging/log.h>

LOG_MODULE_REGISTER(data, LOG_LEVEL_INF);

// Global instances
struct imu_data g_imu_data;
struct baro_data g_baro_data;
struct state_data g_state_data;

// Mutexes for thread safety
K_MUTEX_DEFINE(imu_mutex);
K_MUTEX_DEFINE(baro_mutex);
K_MUTEX_DEFINE(state_mutex);

// Setter functions
void set_imu_data(const struct imu_data *src)
{
    k_mutex_lock(&imu_mutex, K_FOREVER);
    g_imu_data = *src;
    k_mutex_unlock(&imu_mutex);
}

void set_baro_data(const struct baro_data *src)
{
    k_mutex_lock(&baro_mutex, K_FOREVER);
    g_baro_data = *src;
    k_mutex_unlock(&baro_mutex);
}

// Getter functions
void get_imu_data(struct imu_data *dst)
{
    k_mutex_lock(&imu_mutex, K_FOREVER);
    *dst = g_imu_data;
    k_mutex_unlock(&imu_mutex);
}

void get_baro_data(struct baro_data *dst)
{
    k_mutex_lock(&baro_mutex, K_FOREVER);
    *dst = g_baro_data;
    k_mutex_unlock(&baro_mutex);
}

void set_state_data(const struct state_data *src)
{
    k_mutex_lock(&state_mutex, K_FOREVER);
    g_state_data = *src;
    k_mutex_unlock(&state_mutex);
}

void get_state_data(struct state_data *dst)
{
    k_mutex_lock(&state_mutex, K_FOREVER);
    *dst = g_state_data;
    k_mutex_unlock(&state_mutex);
}
```

## src/data.h
```c
#ifndef DATA_H
#define DATA_H

#include <stdint.h>

// Data structures for sensor data
struct imu_data {
  float accel[3];    // Acceleration in m/s²
  float gyro[3];     // Angular velocity in rad/s
  int64_t timestamp; // Timestamp in milliseconds
};

// Per-barometer sensor data
struct baro_sensor_data {
  float pressure;    // Pressure in Pa
  float temperature; // Temperature in °C
  float altitude;    // Altitude in meters (from pressure + temp)
  float nis;         // Normalized innovation squared
  uint8_t faults;    // Accumulated fault count
  bool healthy;      // Health status (accepted/rejected)
};

// Combined barometer data (shared with other threads)
struct baro_data {
  struct baro_sensor_data baro0; // Barometer 0
  struct baro_sensor_data baro1; // Barometer 1

  float altitude;     // Kalman-filtered altitude estimate in meters
  float alt_variance; // Kalman filter variance (P)
  float velocity;     // Vertical velocity estimate (m/s)
  float vel_variance; // Velocity variance (P11)

  int64_t timestamp; // Timestamp in milliseconds
};

// Global instances
extern struct imu_data g_imu_data;
extern struct baro_data g_baro_data;

// Getters and setters
void set_imu_data(const struct imu_data *src);
void get_imu_data(struct imu_data *dst);

void set_baro_data(const struct baro_data *src);
void get_baro_data(struct baro_data *dst);

#endif
```

## src/log_format.h
```c
#ifndef LOG_FORMAT_H
#define LOG_FORMAT_H

#include "data.h"
#include <stdint.h>

struct log_frame {
  int64_t log_timestamp;

  struct imu_data imu;
  struct baro_data baro;
};

#endif
```

## src/logger_thread.c
```c
#include "data.h"
#include "log_format.h"
#include <ff.h>
#include <stdio.h>
#include <string.h>
#include <zephyr/device.h>
#include <zephyr/fs/fs.h>
#include <zephyr/kernel.h>
#include <zephyr/logging/log.h>
#include <zephyr/storage/disk_access.h>
#include <zephyr/sys/printk.h>

LOG_MODULE_REGISTER(logger_thread, LOG_LEVEL_INF);

#define LOGGER_THREAD_STACK_SIZE 2048
#define LOGGER_THREAD_PRIORITY 7
#define LOGGER_THREAD_PERIOD_MS 50
#define LOGGER_SYNC_PERIOD_MS 500

#define SDMMC_NODE DT_ALIAS(sdmmc1)
#define DISK_DRIVE_NAME "SD" // DT_PROP(SDMMC_NODE, disk_name)
#define MOUNT_POINT "/" DISK_DRIVE_NAME ":"

static FATFS fat_fs;
static struct fs_mount_t fatfs_mnt = {
    .type = FS_FATFS, .mnt_point = MOUNT_POINT, .fs_data = &fat_fs};

K_THREAD_STACK_DEFINE(logger_stack, LOGGER_THREAD_STACK_SIZE);
static struct k_thread logger_thread;

static struct fs_file_t log_file;
static char log_file_name[32];

static int mount_sd_card(void)
{
    int ret;

    // Initialize the SDMMC disk
    ret = disk_access_ioctl(DISK_DRIVE_NAME, DISK_IOCTL_CTRL_INIT, NULL);
    if (ret < 0) {
        LOG_ERR("Disk access initialization failed: %d", ret);
        return ret;
    }

    // Mount the FATFS file system
    ret = fs_mount(&fatfs_mnt);
    if (ret == 0) {
        LOG_INF("File system mounted at %s", fatfs_mnt.mnt_point);
    } else {
        LOG_ERR("File system mount failed: %d", ret);
    }

    return ret;
}

static int write_csv_header(void)
{
    const char *header = "Log_Timestamp(ms),"
                         "IMU_Timestamp(ms),Accel_X(m/s^2),Accel_Y(m/s^2),Accel_Z(m/s^2),"
                         "Gyro_X(rad/s),Gyro_Y(rad/s),Gyro_Z(rad/s),"
                         "Baro_Timestamp(ms),"
                         "Baro0_Pressure(Pa),Baro0_Temperature(C),Baro0_Altitude(m),Baro0_NIS,"
                         "Baro0_Faults,Baro0_Healthy,"
                         "Baro1_Pressure(Pa),Baro1_Temperature(C),Baro1_Altitude(m),Baro1_NIS,"
                         "Baro1_Faults,Baro1_Healthy,"
                         "KF_Altitude(m),KF_AltVar,KF_Velocity(m/s),KF_VelVar,"
                         "State,State_Ground_Altitude(m),State_Timestamp(ms)\n";
    int ret;

    // Write the header row to the log file
    ret = fs_write(&log_file, header, strlen(header));
    if (ret < 0) {
        LOG_ERR("Failed to write header to log file: %d", ret);
        return ret;
    }

    // Flush the header to the SD card
    ret = fs_sync(&log_file);
    if (ret < 0) {
        LOG_ERR("Failed to sync log file after writing header: %d", ret);
        return ret;
    }

    return 0;
}

static int create_new_log_file(void)
{
    int ret;
    struct fs_dir_t dir;
    struct fs_dirent entry;
    int file_count = 0;

    // Open the directory
    fs_dir_t_init(&dir);
    ret = fs_opendir(&dir, MOUNT_POINT);
    if (ret < 0) {
        LOG_ERR("Failed to open directory: %d", ret);
        return ret;
    }

    // Count the number of files in the directory
    while (fs_readdir(&dir, &entry) == 0 && entry.name[0] != '\0') {
        if (entry.type == FS_DIR_ENTRY_FILE) {
            file_count++;
        }
    }

    fs_closedir(&dir);

    // Generate a new log file name
    snprintf(log_file_name, sizeof(log_file_name), MOUNT_POINT "/log_%d.csv", file_count);

    // Initialize the file
    fs_file_t_init(&log_file);

    // Open the file for appending (create if it doesn't exist)
    ret = fs_open(&log_file, log_file_name, FS_O_CREATE | FS_O_APPEND | FS_O_WRITE);
    if (ret < 0) {
        LOG_ERR("Failed to open log file: %d", ret);
        return ret;
    }

    LOG_INF("Log file created: %s", log_file_name);

    // Attempt to write the header row to the log file
    ret = write_csv_header();
    if (ret < 0) {
        LOG_ERR("Failed to write header to log file. Continuing without header.");
        // Do not close the file; allow further writes to continue
    }

    return 0;
}

static int format_log_entry(const struct log_frame *frame, char *buffer, size_t buffer_size)
{
    return snprintf(
        buffer, buffer_size,
        "%lld,%lld,%.3f,%.3f,%.3f,%.3f,%.3f,%.3f,%lld,"
        "%.3f,%.3f,%.3f,%.3f,%u,%d,"
        "%.3f,%.3f,%.3f,%.3f,%u,%d,"
        "%.3f,%.3f,%.3f,%.3f,%d,%.3f,%lld\n",
        frame->log_timestamp,
        frame->imu.timestamp, // IMU timestamp
        (double)frame->imu.accel[0], (double)frame->imu.accel[1], (double)frame->imu.accel[2],
        (double)frame->imu.gyro[0], (double)frame->imu.gyro[1], (double)frame->imu.gyro[2],
        frame->baro.timestamp, // Barometer timestamp
        (double)frame->baro.baro0.pressure, (double)frame->baro.baro0.temperature,
        (double)frame->baro.baro0.altitude, (double)frame->baro.baro0.nis,
        (unsigned int)frame->baro.baro0.faults, frame->baro.baro0.healthy ? 1 : 0,
        (double)frame->baro.baro1.pressure, (double)frame->baro.baro1.temperature,
        (double)frame->baro.baro1.altitude, (double)frame->baro.baro1.nis,
        (unsigned int)frame->baro.baro1.faults, frame->baro.baro1.healthy ? 1 : 0,
        (double)frame->baro.altitude, (double)frame->baro.alt_variance,
        (double)frame->baro.velocity, (double)frame->baro.vel_variance, (int)frame->state.state,
        (double)frame->state.ground_altitude, frame->state.timestamp);
}

static void write_log_frame_to_file(const struct log_frame *frame)
{
    char log_entry[512];
    int len;

    // Format the log entry as CSV
    len = format_log_entry(frame, log_entry, sizeof(log_entry));

    // Check if the formatted string was truncated
    if (len >= sizeof(log_entry)) {
        LOG_ERR("Log buffer size: %zu, Required size: %d", sizeof(log_entry), len);
        len = sizeof(log_entry) - 1; // Write only up to the buffer size (excluding null terminator)
        return;                      // Abort to avoid writing incomplete log entry
    } else if (len < 0) {
        LOG_ERR("Failed to format log entry: %d", len);
        return; // Abort if formatting failed
    }

    // Write the log entry to the file
    int ret = fs_write(&log_file, log_entry, len);
    if (ret < 0) {
        LOG_ERR("Failed to write to log file: %d", ret);
        return;
    }
}

static void logger_thread_fn(void *p1, void *p2, void *p3)
{
    struct log_frame frame;

    if (mount_sd_card() < 0) {
        return;
    }

    if (create_new_log_file() < 0) {
        return;
    }

    int64_t last_sync_ms = k_uptime_get();

    while (1) {
        // Collect data
        frame.log_timestamp = k_uptime_get();
        get_imu_data(&frame.imu);
        get_baro_data(&frame.baro);
        get_state_data(&frame.state);

        // Write the data to the log file
        write_log_frame_to_file(&frame);

        if ((frame.log_timestamp - last_sync_ms) >= LOGGER_SYNC_PERIOD_MS) {
            int ret = fs_sync(&log_file);
            if (ret < 0) {
                LOG_ERR("Failed to sync log file: %d", ret);
            } else {
                last_sync_ms = frame.log_timestamp;
            }
        }

        k_sleep(K_MSEC(LOGGER_THREAD_PERIOD_MS));
    }
}

void start_logger_thread()
{
    k_thread_create(&logger_thread, logger_stack, K_THREAD_STACK_SIZEOF(logger_stack),
                    logger_thread_fn, NULL, NULL, NULL, LOGGER_THREAD_PRIORITY, 0, K_NO_WAIT);
}
```

## src/logger_thread.h
```c
#ifndef LOGGER_THREAD_H
#define LOGGER_THREAD_H

#include <stdint.h>

void start_logger_thread();

#endif
```

## src/state_machine.c
```c
#include <math.h>
#include <stdbool.h>
#include <stdint.h>

#include <zephyr/kernel.h>
#include <zephyr/logging/log.h>
#include <zephyr/smf.h>

#include "state_machine.h"

LOG_MODULE_REGISTER(state_machine, LOG_LEVEL_INF);

#define STATE_THREAD_STACK_SIZE 2048
#define STATE_THREAD_PRIORITY   5
#define STATE_THREAD_PERIOD_MS  20

// Standby baseline
#define GROUND_AVERAGE_SAMPLES             10

// Ascent detection
#define ASCENT_ALTITUDE_THRESHOLD_M        25.0f
#define ASCENT_VELOCITY_THRESHOLD_MPS      5.0f
#define ASCENT_CHECKS                      5

// Mach lock
#define MACH_LOCK_VELOCITY_THRESHOLD_MPS   150.0f
#define MACH_LOCK_CHECKS                   10
#define MACH_UNLOCK_VELOCITY_THRESHOLD_MPS 150.0f
#define MACH_UNLOCK_CHECKS                 10

// Drogue deployment
#define DROGUE_DEPLOY_VELOCITY_THRESHOLD_MPS  5.0f
#define DROGUE_DEPLOY_CHECKS                 5
#define DROGUE_DEPLOY_DELAY_MS               3000

// Main deployment
#define MAIN_DEPLOY_ALTITUDE_M             488.0f
#define MAIN_DEPLOY_CHECKS                 5

// Landing detection
#define LANDED_VELOCITY_THRESHOLD_MPS      4.0f
#define LANDED_CHECKS                      6
#define LANDED_CHECK_INTERVAL_MS           10000

typedef struct
{
    uint8_t count;
} repeated_check_t;

typedef struct
{
    float altitude_m;
    float velocity_mps;
    int64_t timestamp_ms;
} state_sample_t;

struct flight_sm
{
    struct smf_ctx ctx;
    flight_state_id_t current_id;
    int64_t entry_time_ms;
    state_sample_t sample;
    float ground_altitude_m;
    float ground_sum_m;
    uint8_t ground_samples;
    bool ground_ready;
    repeated_check_t standby_check;
    repeated_check_t mach_lock_check;
    repeated_check_t mach_unlock_check;
    repeated_check_t drogue_main_check;
    repeated_check_t landed_check;
    int64_t last_landed_check_ms;
    bool drogue_fired;
};

static K_THREAD_STACK_DEFINE(state_stack, STATE_THREAD_STACK_SIZE);
static struct k_thread state_thread;
static struct flight_sm state_machine;

static const struct smf_state flight_states[];

/**
 * @brief Update a repeated-check counter and report when it reaches the threshold.
 */
static bool repeated_check_update(repeated_check_t *check, bool condition, uint8_t required)
{
    if (condition) {
        if (check->count < 255) {
            check->count++;
        }
    } else {
        check->count = 0;
    }

    return check->count >= required;
}

/**
 * @brief Clear a repeated-check counter.
 */
static void reset_repeated_check(repeated_check_t *check)
{
    check->count = 0;
}

/**
 * @brief Reset ground altitude averaging state.
 */
static void reset_ground_average(struct flight_sm *sm)
{
    sm->ground_altitude_m = 0.0f;
    sm->ground_sum_m = 0.0f;
    sm->ground_samples = 0;
    sm->ground_ready = false;
}

/**
 * @brief Convert an absolute altitude to altitude relative to ground baseline.
 */
static float get_relative_altitude(const struct flight_sm *sm, float altitude_m)
{
    return altitude_m - sm->ground_altitude_m;
}

/**
 * @brief Trigger drogue deployment action.
 */
static void state_action_fire_drogue(void)
{
    LOG_INF("Drogue deployment triggered");
    // TODO: Signal drogue deployment here
}

/**
 * @brief Trigger main parachute deployment action.
 */
static void state_action_fire_main(void)
{
    LOG_INF("Main deployment triggered");
    // TODO: Signal main deployment here
}

/**
 * @brief Trigger landed action.
 */
static void state_action_landed(void)
{
    LOG_INF("The rocket has landed");
    // TODO: Need to do anything upon landing?
}

/**
 * @brief Return a human-readable string for a flight state.
 */
const char *flight_state_to_string(flight_state_id_t state)
{
    switch (state) {
    case FLIGHT_STATE_STANDBY:
        return "STANDBY";
    case FLIGHT_STATE_ASCENT:
        return "ASCENT";
    case FLIGHT_STATE_MACH_LOCK:
        return "MACH_LOCK";
    case FLIGHT_STATE_DROGUE_DESCENT:
        return "DROGUE_DESCENT";
    case FLIGHT_STATE_MAIN_DESCENT:
        return "MAIN_DESCENT";
    case FLIGHT_STATE_LANDED:
        return "LANDED";
    default:
        return "UNKNOWN";
    }
}

/**
 * @brief Common entry bookkeeping shared by all states.
 */
static void state_entry_common(struct flight_sm *sm, flight_state_id_t state)
{
    sm->current_id = state;
    sm->entry_time_ms = sm->sample.timestamp_ms;
}

/**
 * @brief Evaluate transitions while in standby (includes ground averaging).
 */
static flight_state_id_t update_standby(struct flight_sm *sm, const state_sample_t *sample)
{
    if (!sm->ground_ready) {
        sm->ground_sum_m += sample->altitude_m;
        sm->ground_samples++;
        if (sm->ground_samples >= GROUND_AVERAGE_SAMPLES) {
            sm->ground_altitude_m = sm->ground_sum_m / (float)sm->ground_samples;
            sm->ground_ready = true;
        }
        return FLIGHT_STATE_STANDBY;
    }

    float rel_altitude = get_relative_altitude(sm, sample->altitude_m);
    bool ascent_condition = (rel_altitude > ASCENT_ALTITUDE_THRESHOLD_M) &&
                            (sample->velocity_mps > ASCENT_VELOCITY_THRESHOLD_MPS);

    if (repeated_check_update(&sm->standby_check, ascent_condition, ASCENT_CHECKS)) {
        return FLIGHT_STATE_ASCENT;
    }

    return FLIGHT_STATE_STANDBY;
}

/**
 * @brief Evaluate transitions while in ascent.
 */
static flight_state_id_t update_ascent(struct flight_sm *sm, const state_sample_t *sample)
{
    bool mach_lock = sample->velocity_mps > MACH_LOCK_VELOCITY_THRESHOLD_MPS;

    if (repeated_check_update(&sm->mach_lock_check, mach_lock, MACH_LOCK_CHECKS)) {
        return FLIGHT_STATE_MACH_LOCK;
    }

    bool drogue = sample->velocity_mps < DROGUE_DEPLOY_VELOCITY_THRESHOLD_MPS;
    if (repeated_check_update(&sm->drogue_main_check, drogue, DROGUE_DEPLOY_CHECKS)) {
        return FLIGHT_STATE_DROGUE_DESCENT;
    }

    return FLIGHT_STATE_ASCENT;
}

/**
 * @brief Evaluate transitions while in mach lock.
 */
static flight_state_id_t update_mach_lock(struct flight_sm *sm, const state_sample_t *sample)
{
    bool below_unlock = sample->velocity_mps < MACH_UNLOCK_VELOCITY_THRESHOLD_MPS;

    if (repeated_check_update(&sm->mach_unlock_check, below_unlock, MACH_UNLOCK_CHECKS)) {
        return FLIGHT_STATE_ASCENT;
    }

    return FLIGHT_STATE_MACH_LOCK;
}

/**
 * @brief Evaluate transitions while in drogue descent.
 */
static flight_state_id_t update_drogue_descent(struct flight_sm *sm, const state_sample_t *sample)
{
    if (!sm->drogue_fired) {
        return FLIGHT_STATE_DROGUE_DESCENT;
    }

    float rel_altitude = get_relative_altitude(sm, sample->altitude_m);
    bool below_main_alt = rel_altitude < MAIN_DEPLOY_ALTITUDE_M;

    if (repeated_check_update(&sm->drogue_main_check, below_main_alt, MAIN_DEPLOY_CHECKS)) {
        return FLIGHT_STATE_MAIN_DESCENT;
    }

    return FLIGHT_STATE_DROGUE_DESCENT;
}

/**
 * @brief Evaluate transitions while in main descent.
 */
static flight_state_id_t update_main_descent(struct flight_sm *sm, const state_sample_t *sample)
{
    bool landed = fabsf(sample->velocity_mps) < LANDED_VELOCITY_THRESHOLD_MPS;

    if (landed) {
        int64_t elapsed = sample->timestamp_ms - sm->last_landed_check_ms;
        if (elapsed >= LANDED_CHECK_INTERVAL_MS) {
            sm->last_landed_check_ms = sample->timestamp_ms;
            if (repeated_check_update(&sm->landed_check, true, LANDED_CHECKS)) {
                return FLIGHT_STATE_LANDED;
            }
        }
    } else {
        repeated_check_update(&sm->landed_check, false, LANDED_CHECKS);
        sm->last_landed_check_ms = sample->timestamp_ms;
    }

    return FLIGHT_STATE_MAIN_DESCENT;
}

/**
 * @brief Maintain the terminal landed state.
 */
static flight_state_id_t update_landed(void)
{
    return FLIGHT_STATE_LANDED;
}

/**
 * @brief Transition the SMF context to a new state with logging.
 */
static void transition_to(struct flight_sm *sm, flight_state_id_t next_state)
{
    if (next_state == sm->current_id) {
        return;
    }

    LOG_INF("State change: %s -> %s",
            flight_state_to_string(sm->current_id),
            flight_state_to_string(next_state));
    smf_set_state(SMF_CTX(sm), &flight_states[next_state]);
}

/**
 * @brief SMF entry handler for standby state.
 */
static void state_standby_entry(void *obj)
{
    struct flight_sm *sm = obj;

    state_entry_common(sm, FLIGHT_STATE_STANDBY);
    reset_repeated_check(&sm->standby_check);
    reset_ground_average(sm);
}

/**
 * @brief SMF run handler for standby state.
 */
static enum smf_state_result state_standby_run(void *obj)
{
    struct flight_sm *sm = obj;

    transition_to(sm, update_standby(sm, &sm->sample));
    return SMF_EVENT_HANDLED;
}

/**
 * @brief SMF entry handler for ascent state.
 */
static void state_ascent_entry(void *obj)
{
    struct flight_sm *sm = obj;

    state_entry_common(sm, FLIGHT_STATE_ASCENT);
    reset_repeated_check(&sm->mach_lock_check);
    reset_repeated_check(&sm->drogue_main_check);
}

/**
 * @brief SMF run handler for ascent state.
 */
static enum smf_state_result state_ascent_run(void *obj)
{
    struct flight_sm *sm = obj;

    transition_to(sm, update_ascent(sm, &sm->sample));
    return SMF_EVENT_HANDLED;
}

/**
 * @brief SMF entry handler for mach lock state.
 */
static void state_mach_lock_entry(void *obj)
{
    struct flight_sm *sm = obj;

    state_entry_common(sm, FLIGHT_STATE_MACH_LOCK);
    reset_repeated_check(&sm->mach_unlock_check);
}

/**
 * @brief SMF run handler for mach lock state.
 */
static enum smf_state_result state_mach_lock_run(void *obj)
{
    struct flight_sm *sm = obj;

    transition_to(sm, update_mach_lock(sm, &sm->sample));
    return SMF_EVENT_HANDLED;
}

/**
 * @brief SMF entry handler for drogue descent state.
 */
static void state_drogue_descent_entry(void *obj)
{
    struct flight_sm *sm = obj;

    state_entry_common(sm, FLIGHT_STATE_DROGUE_DESCENT);
    reset_repeated_check(&sm->drogue_main_check);
    sm->drogue_fired = false;
}

/**
 * @brief SMF run handler for drogue descent state.
 */
static enum smf_state_result state_drogue_descent_run(void *obj)
{
    struct flight_sm *sm = obj;

    if (!sm->drogue_fired &&
        (sm->sample.timestamp_ms - sm->entry_time_ms) >= DROGUE_DEPLOY_DELAY_MS) {
        state_action_fire_drogue();
        sm->drogue_fired = true;
    }

    transition_to(sm, update_drogue_descent(sm, &sm->sample));
    return SMF_EVENT_HANDLED;
}

/**
 * @brief SMF entry handler for main descent state.
 */
static void state_main_descent_entry(void *obj)
{
    struct flight_sm *sm = obj;

    state_entry_common(sm, FLIGHT_STATE_MAIN_DESCENT);
    reset_repeated_check(&sm->landed_check);
    sm->last_landed_check_ms = sm->sample.timestamp_ms;
    state_action_fire_main();
}

/**
 * @brief SMF run handler for main descent state.
 */
static enum smf_state_result state_main_descent_run(void *obj)
{
    struct flight_sm *sm = obj;

    transition_to(sm, update_main_descent(sm, &sm->sample));
    return SMF_EVENT_HANDLED;
}

/**
 * @brief SMF entry handler for landed state.
 */
static void state_landed_entry(void *obj)
{
    struct flight_sm *sm = obj;

    state_entry_common(sm, FLIGHT_STATE_LANDED);
    state_action_landed();
}

/**
 * @brief SMF run handler for landed state.
 */
static enum smf_state_result state_landed_run(void *obj)
{
    struct flight_sm *sm = obj;

    transition_to(sm, update_landed());
    return SMF_EVENT_HANDLED;
}

static const struct smf_state flight_states[] = {
    [FLIGHT_STATE_STANDBY] =
        SMF_CREATE_STATE(state_standby_entry, state_standby_run, NULL, NULL, NULL),
    [FLIGHT_STATE_ASCENT] =
        SMF_CREATE_STATE(state_ascent_entry, state_ascent_run, NULL, NULL, NULL),
    [FLIGHT_STATE_MACH_LOCK] =
        SMF_CREATE_STATE(state_mach_lock_entry, state_mach_lock_run, NULL, NULL, NULL),
    [FLIGHT_STATE_DROGUE_DESCENT] =
        SMF_CREATE_STATE(state_drogue_descent_entry, state_drogue_descent_run, NULL, NULL, NULL),
    [FLIGHT_STATE_MAIN_DESCENT] =
        SMF_CREATE_STATE(state_main_descent_entry, state_main_descent_run, NULL, NULL, NULL),
    [FLIGHT_STATE_LANDED] =
        SMF_CREATE_STATE(state_landed_entry, state_landed_run, NULL, NULL, NULL),
};

/**
 * @brief State machine thread loop that drives SMF with baro samples.
 */
static void state_machine_thread_fn(void *p1, void *p2, void *p3)
{
    struct baro_data baro;

    while (1) {
        get_baro_data(&baro);
        int64_t now_ms = (baro.timestamp > 0) ? baro.timestamp : k_uptime_get();

        state_machine.sample.altitude_m = baro.altitude;
        state_machine.sample.velocity_mps = baro.velocity;
        state_machine.sample.timestamp_ms = now_ms;

        smf_run_state(SMF_CTX(&state_machine));
        flight_state_id_t current = state_machine.current_id;

        struct state_data data = {
            .state = current,
            .ground_altitude = state_machine.ground_altitude_m,
            .timestamp = now_ms,
        };
        set_state_data(&data);

        k_sleep(K_MSEC(STATE_THREAD_PERIOD_MS));
    }
}

/**
 * @brief Start the state machine thread and initialize SMF.
 */
void start_state_machine_thread(void)
{
    state_machine.sample.timestamp_ms = k_uptime_get();
    smf_set_initial(SMF_CTX(&state_machine), &flight_states[FLIGHT_STATE_STANDBY]);

    k_thread_create(
        &state_thread,
        state_stack,
        K_THREAD_STACK_SIZEOF(state_stack),
        state_machine_thread_fn,
        NULL, NULL, NULL,
        STATE_THREAD_PRIORITY,
        0,
        K_NO_WAIT
    );
}
```
