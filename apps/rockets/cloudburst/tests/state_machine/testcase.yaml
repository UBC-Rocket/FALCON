## apps/rockets/cloudburst/tests/state_machine/testcase.yaml
```yaml
tests:
    cloudburst.state_machine:
        platform_allow: ubcrocket_fc_2526_r1
        tags: state_machine
        type: unit
```

## boards/st/ubcrocket_fc_2526_r1/Kconfig.ubcrocket_fc_2526_r1
```kconfig
# Copyright (c) 2023 Thomas Stranger
# SPDX-License-Identifier: Apache-2.0

config BOARD_UBCROCKET_FC_2526_R1
	select SOC_STM32H563XX
```

## boards/st/ubcrocket_fc_2526_r1/board.yml
```yaml
board:
    name: ubcrocket_fc_2526_r1
    full_name: UBC Rocket Flight Controller 2025-26 Rev 1.0
    vendor: st
    socs:
        - name: stm32h563xx
 
```

## boards/ubcrocket/polarity/Kconfig.ubcrocket_polarity
```kconfig
# Copyright (c) 2023 Thomas Stranger
# SPDX-License-Identifier: Apache-2.0

config BOARD_UBCROCKET_POLARITY
	select SOC_STM32H563XX
```

## boards/ubcrocket/polarity/board.yml
```yaml
board:
    name: ubcrocket_polarity
    full_name: UBC Rocket Flight Controller / Project Polarity 2025-26 Rev 1.1
    vendor: ubcrocket
    socs:
        - name: stm32h563xx
```

## drivers/sensor/Kconfig
```kconfig
if SENSOR
rsource "ms5611/Kconfig"
rsource "sim_baro/Kconfig"
rsource "sim_accel/Kconfig"
rsource "sim_gyro/Kconfig"
rsource "sim_sdmmc/Kconfig"
rsource "sim_pyro/Kconfig"
endif # SENSOR
```

## drivers/sensor/ms5611/Kconfig
```kconfig
# MS5611 pressure sensor configuration options

# Copyright (c) 2019 Thomas Schmid <tom@lfence.de>
# SPDX-License-Identifier: Apache-2.0

menuconfig MS5611
	bool "MS5611 pressure and temperature sensor"
	default y
	depends on DT_HAS_MEAS_MS5611_ENABLED
	select I2C if $(dt_compat_on_bus,$(DT_COMPAT_MEAS_MS5611),i2c)
	select SPI if $(dt_compat_on_bus,$(DT_COMPAT_MEAS_MS5611),spi)
	help
	  Enable driver for MS5611 pressure and temperature sensor.

if MS5611

choice
	prompt "Pressure oversampling."
	default MS5611_PRES_OVER_2048X

config MS5611_PRES_OVER_256X
	bool "x256"

config MS5611_PRES_OVER_512X
	bool "x512"

config MS5611_PRES_OVER_1024X
	bool "x1024"

config MS5611_PRES_OVER_2048X
	bool "x2048"

config MS5611_PRES_OVER_4096X
	bool "x4096"

endchoice


choice
	prompt "Temperature oversampling."
	default MS5611_TEMP_OVER_2048X

config MS5611_TEMP_OVER_256X
	bool "x256"

config MS5611_TEMP_OVER_512X
	bool "x512"

config MS5611_TEMP_OVER_1024X
	bool "x1024"

config MS5611_TEMP_OVER_2048X
	bool "x2048"

config MS5611_TEMP_OVER_4096X
	bool "x4096"

endchoice

endif # MS5611
```

## drivers/sensor/sim_accel/Kconfig
```kconfig
config SIM_ACCEL
    bool "Simulated accel sensor"
    depends on DT_HAS_ZEPHYR_SIM_ACCEL_ENABLED
```

## drivers/sensor/sim_baro/Kconfig
```kconfig
config SIM_BARO
    bool "Simulated barometer"
    depends on NATIVE_SIM && SENSOR
```

## drivers/sensor/sim_common/Kconfig
```kconfig
config SIM_SENSORS
    bool "Simulated sensors for native_sim"
    depends on DT_HAS_ZEPHYR_SIM_SENSORS_ENABLED
    help
      Enable simulated sensors for Zephyr's native sim
```

## drivers/sensor/sim_gyro/Kconfig
```kconfig
config SIM_GYRO
    bool "Simulated gyro sensor"
    depends on DT_HAS_ZEPHYR_SIM_GYRO_ENABLED
```

## drivers/sensor/sim_sdmmc/Kconfig
```kconfig
config SIM_SDMMC
    bool "Simulated sdmmc"
    depends on DT_HAS_ZEPHYR_SIM_SDMMC_ENABLED
```

## drivers/spi/sim_pyro/Kconfig
```kconfig
config SIM_PYRO
    bool "Simulated Pyro Board"
    depends on DT_HAS_ZEPHYR_SIM_PYRO_ENABLED
```

## dts/bindings/sensor/meas,ms5611-i2c.yaml
```yaml
# Copyright (c) 2021, Aurelien Jarno <aurel32@aurel32.net>
# SPDX-License-Identifier: Apache-2.0

description: |
    TE Connectivity MS5611 digital pressure and temperature sensor.
    The Datasheet is at https://www.te.com/usa-en/product-CAT-BLPS0035.html

compatible: "meas,ms5611"

include: [sensor-device.yaml, i2c-device.yaml]
```

## dts/bindings/sensor/zephyr,sim-accel.yaml
```yaml
description: Simulated Accelerometer for native_sim
compatible: "zephyr,sim-accel"
include: sensor-device.yaml
```

## dts/bindings/sensor/zephyr,sim-baro.yaml
```yaml
description: Simulated Barometer for native_sim
compatible: "zephyr,sim-baro"
include: sensor-device.yaml
```

## dts/bindings/sensor/zephyr,sim-gyro.yaml
```yaml
description: Simulated Gyro for native_sim
compatible: "zephyr,sim-gyro"
include: sensor-device.yaml
```

## dts/bindings/sensor/zephyr,sim-pyro.yaml
```yaml
description: Simulated Pyro board for native_sim
compatible: "zephyr,sim-pyro"
include: [sensor-device.yaml, spi-device.yaml]

properties:
  spi-max-frequency:
    type: int
    required: true
    description: Maximum SPI frequency in Hz

  duplex:
    type: int
    description: SPI duplex mode (full-duplex, half-duplex, etc.)

  frame-format:
    type: int
    description: SPI frame format (Motorola, TI, etc.)

  spi-interframe-delay-ns:
    type: int
    description: Inter-frame delay in nanoseconds
```

## dts/bindings/sensor/zephyr,sim-sdmmc-disk.yaml
```yaml
description: Simulated SDMMC Disk for native_sim
compatible: "zephyr,sim-sdmmc-disk"
include: sensor-device.yaml

properties:
  disk_name:
    type: string
    required: true
    description: |
      The string name used to identify the disk (e.g., "SD" or "RAM")
      This must match what is passed to disk_access_init().
```

## dts/bindings/spi/zephyr,sim-pyro.yaml
```yaml
description: Simulated Pyro Device

compatible: "zephyr,sim-pyro"

include: [spi-device.yaml]

properties:
  reg:
    required: true
  
  spi-max-frequency:
    required: true
```

## firmware/tests/state_machine/testcase.yaml
```yaml
tests:
    cloudburst.state_machine:
        platform_allow: ubcrocket_polarity
        tags: state_machine
        type: unit
```

## west.yml
```yaml
manifest:
  remotes:
    - name: zephyrproject-rtos
      url-base: https://github.com/zephyrproject-rtos
    - name: ubc-rocket
      url-base: https://github.com/UBC-Rocket

  projects:
    - name: zephyr
      remote: zephyrproject-rtos
      revision: v4.3.0
      import: true
    - name: falcon-protos
      remote: ubc-rocket
      revision: main
      path: modules/falcon-protos

  self:
    path: app
```
